## Documentation/devicetree/bindings/usb/zhihe,a210-dwc3.yaml
```yaml
# SPDX-License-Identifier: (GPL-2.0-only OR BSD-2-Clause)
%YAML 1.2
---
$id: http://devicetree.org/schemas/usb/zhihe,a210-dwc3.yaml#
$schema: http://devicetree.org/meta-schemas/core.yaml#

title: Zhihe A210 Synopsys DesignWare USB3 controller

maintainers:
  - Han Gao <gaohan@iscas.ac.cn>

select:
  properties:
    compatible:
      contains:
        const: zhihe,a210-dwc3
  required:
    - compatible

properties:
  compatible:
    items:
      - const: zhihe,a210-dwc3
      - const: snps,dwc3

  interrupts:
    maxItems: 1

  clocks:
    items:
      - description: Controller bus clock
      - description: Controller reference clock
      - description: Controller suspend clock

  clock-names:
    items:
      - const: bus_early
      - const: ref
      - const: suspend

  resets:
    maxItems: 1

  phys:
    maxItems: 2

  phy-names:
    items:
      - const: usb2-phy
      - const: usb3-phy

  power-domains:
    maxItems: 1

required:
  - compatible
  - reg
  - interrupts
  - clocks
  - clock-names
  - resets
  - phys
  - phy-names
  - power-domains

allOf:
  - $ref: snps,dwc3.yaml#

unevaluatedProperties: false

examples:
  - |
    #include <dt-bindings/interrupt-controller/irq.h>

    usb@8100000 {
        compatible = "zhihe,a210-dwc3", "snps,dwc3";
        reg = <0x08100000 0x100000>;
        interrupts = <183 IRQ_TYPE_LEVEL_HIGH>;
        clocks = <&scmi_clk 59>, <&scmi_clk 57>, <&scmi_clk 58>;
        clock-names = "bus_early", "ref", "suspend";
        resets = <&scmi_reset 84>;
        phys = <&usb2_phy>, <&usb3_phy>;
        phy-names = "usb2-phy", "usb3-phy";
        power-domains = <&scmi_power 3>;
    };
```

## bsp/Kconfig
```kconfig
# SPDX-License-Identifier: GPL-2.0

menu "Allwinner BSP"

source "platform/Kconfig"
source "platform/Kconfig.debug"
source "bsp/drivers/Kconfig"
source "modules/nand/Kconfig"
source "modules/gpu/Kconfig"

endmenu
```
