## Documentation/devicetree/bindings/clock/allwinner,sun252i-v861-ccu.yaml
```yaml
# SPDX-License-Identifier: (GPL-2.0-only OR BSD-2-Clause)
%YAML 1.2
---
$id: http://devicetree.org/schemas/clock/allwinner,sun252i-v861-ccu.yaml#
$schema: http://devicetree.org/meta-schemas/core.yaml#

title: Allwinner V861 Clock Control Unit

maintainers:
  - Han Gao <gaohan@iscas.ac.cn>

properties:
  "#clock-cells":
    const: 1

  "#reset-cells":
    const: 1

  compatible:
    enum:
      - allwinner,sun252i-v861-ccu
      - allwinner,sun252i-v861-r-ccu

  reg:
    maxItems: 1

  clocks:
    minItems: 3
    maxItems: 4

  clock-names:
    minItems: 3
    maxItems: 4

required:
  - "#clock-cells"
  - "#reset-cells"
  - compatible
  - reg
  - clocks
  - clock-names

allOf:
  - if:
      properties:
        compatible:
          enum:
            - allwinner,sun252i-v861-ccu

    then:
      properties:
        clocks:
          items:
            - description: High Frequency Oscillator (usually at 24MHz)
            - description: Low Frequency Oscillator (usually at 32kHz)
            - description: Internal Oscillator

        clock-names:
          items:
            - const: hosc
            - const: losc
            - const: iosc

  - if:
      properties:
        compatible:
          enum:
            - allwinner,sun252i-v861-r-ccu

    then:
      properties:
        clocks:
          items:
            - description: High Frequency Oscillator (usually at 24MHz)
            - description: Low Frequency Oscillator (usually at 32kHz)
            - description: Internal Oscillator
            - description: Peripherals PLL (200 MHz output)

        clock-names:
          items:
            - const: hosc
            - const: losc
            - const: iosc
            - const: pll-periph

additionalProperties: false

examples:
  - |
    clock-controller@2001000 {
        compatible = "allwinner,sun252i-v861-ccu";
        reg = <0x02001000 0x1000>;
        clocks = <&osc24M>, <&rtc 0>, <&rtc 2>;
        clock-names = "hosc", "losc", "iosc";
        #clock-cells = <1>;
        #reset-cells = <1>;
    };

...
```

## Documentation/devicetree/bindings/clock/zhihe,a210-aon-clk.yaml
```yaml
# SPDX-License-Identifier: (GPL-2.0-only OR BSD-2-Clause)
%YAML 1.2
---
$id: http://devicetree.org/schemas/clock/zhihe,a210-aon-clk.yaml#
$schema: http://devicetree.org/meta-schemas/core.yaml#

title: Zhihe A210 always-on peripheral clock controller

maintainers:
  - Han Gao <gaohan@iscas.ac.cn>

description: |
  The AON clock controller provides a system clock multiplexer and
  divider, along with peripheral clock gates.

properties:
  compatible:
    const: zhihe,a210-aon-clk

  reg:
    maxItems: 1

  clocks:
    items:
      - description: High-speed AON reference
      - description: External oscillator
      - description: Internal RC oscillator
      - description: RTC oscillator

  clock-names:
    items:
      - const: high
      - const: osc
      - const: rc
      - const: rtc

  '#clock-cells':
    const: 1

required:
  - compatible
  - reg
  - clocks
  - clock-names
  - '#clock-cells'

additionalProperties: false

examples:
  - |
    clock-controller@30844000 {
        compatible = "zhihe,a210-aon-clk";
        reg = <0x30844000 0x1c>;
        #clock-cells = <1>;
        clocks = <&aon_high>, <&osc24m>, <&rc26m>, <&rtc32k>;
        clock-names = "high", "osc", "rc", "rtc";
    };
...
```

## Documentation/devicetree/bindings/mailbox/zhihe,a210-ap-mailbox.yaml
```yaml
# SPDX-License-Identifier: (GPL-2.0-only OR BSD-2-Clause)
%YAML 1.2
---
$id: http://devicetree.org/schemas/mailbox/zhihe,a210-ap-mailbox.yaml#
$schema: http://devicetree.org/meta-schemas/core.yaml#

title: Zhihe A210 application processor to E902 mailbox

maintainers:
  - Han Gao <gaohan@iscas.ac.cn>

description: |
  The A210 application processors and the E902 always-on core each own a
  mailbox. A core raises an interrupt on the other side by writing the
  generate register of the other core's mailbox, and can leave a value in one
  of the INFO registers there to identify the request. The application
  processor side therefore needs its own mailbox, which holds the INFO
  registers written by E902 and the interrupt status, clear and mask
  registers, and the slice of the E902 mailbox assigned to it.

  The E902 firmware keeps both mailboxes clocked and out of reset. Their
  clocks and resets are not controlled from the application processors.

properties:
  compatible:
    const: zhihe,a210-ap-mailbox

  reg:
    items:
      - description: Application processor mailbox
      - description: Application processor slice of the E902 mailbox

  reg-names:
    items:
      - const: local
      - const: remote

  interrupts:
    maxItems: 1

  '#mbox-cells':
    const: 1
    description:
      Doorbell index, 0 or 1. E902 writes INFO0 or INFO1 of the application
      processor mailbox to tell which doorbell it rings. Only doorbell 0 can
      also be rung by the application processor.

required:
  - compatible
  - reg
  - reg-names
  - interrupts
  - '#mbox-cells'

additionalProperties: false

examples:
  - |
    #include <dt-bindings/interrupt-controller/irq.h>

    mailbox@320000 {
        compatible = "zhihe,a210-ap-mailbox";
        reg = <0x320000 0x2000>, <0x311000 0x1000>;
        reg-names = "local", "remote";
        interrupts = <336 IRQ_TYPE_LEVEL_HIGH>;
        #mbox-cells = <1>;
    };
```

## Documentation/devicetree/bindings/media/thead,th1520-vc8000e.yaml
```yaml
# SPDX-License-Identifier: GPL-2.0-only OR BSD-2-Clause
%YAML 1.2
---
$id: http://devicetree.org/schemas/media/thead,th1520-vc8000e.yaml#
$schema: http://devicetree.org/meta-schemas/core.yaml#

title: T-HEAD TH1520 Hantro VC8000D video encoder

maintainers:
  - Han Gao <gaohan@iscas.ac.cn>

description:
  The VC8000E encoder and its internal address translation unit occupy
  separate register banks.

properties:
  compatible:
    const: thead,th1520-vc8000e

  reg:
    items:
      - description: Encoder core registers
      - description: Internal MMU registers

  reg-names:
    items:
      - const: encoder
      - const: mmu

  interrupts:
    maxItems: 1

  clocks:
    items:
      - description: AXI bus clock
      - description: Encoder core clock
      - description: APB register clock

  clock-names:
    items:
      - const: aclk
      - const: cclk
      - const: pclk

  resets:
    items:
      - description: APB register interface reset
      - description: Encoder core reset

  reset-names:
    items:
      - const: apb
      - const: core

  power-domains:
    maxItems: 1

required:
  - compatible
  - reg
  - reg-names
  - interrupts
  - clocks
  - clock-names
  - resets
  - reset-names
  - power-domains

additionalProperties: false

examples:
  - |
    #include <dt-bindings/clock/thead,th1520-clk-ap.h>
    #include <dt-bindings/interrupt-controller/irq.h>
    #include <dt-bindings/power/thead,th1520-power.h>
    #include <dt-bindings/reset/thead,th1520-reset.h>

    video-codec@ecc11000 {
        compatible = "thead,th1520-vc8000e";
        reg = <0xecc11000 0x1000>, <0xecc14000 0x1000>;
        reg-names = "encoder", "mmu";
        interrupts = <133 IRQ_TYPE_LEVEL_HIGH>;
        clocks = <&clk_vp CLK_VENC_ACLK>,
                 <&clk_vp CLK_VENC_CCLK>,
                 <&clk_vp CLK_VENC_PCLK>;
        clock-names = "aclk", "cclk", "pclk";
        resets = <&rst_vp TH1520_RESET_ID_VENC_APB>,
                 <&rst_vp TH1520_RESET_ID_VENC_CORE>;
        reset-names = "apb", "core";
        power-domains = <&aon TH1520_VENC_PD>;
    };
```

## Documentation/devicetree/bindings/media/zhihe,a210-vc9000d.yaml
```yaml
# SPDX-License-Identifier: GPL-2.0-only OR BSD-2-Clause
%YAML 1.2
---
$id: http://devicetree.org/schemas/media/zhihe,a210-vc9000d.yaml#
$schema: http://devicetree.org/meta-schemas/core.yaml#

title: Zhihe A210 Hantro VC9000D video decoder

maintainers:
  - Han Gao <gaohan@iscas.ac.cn>

description:
  The VC9000D decoder supports H.264, HEVC and VP9. Its register bank
  follows a command unit that this binding does not describe.

properties:
  compatible:
    const: zhihe,a210-vc9000d

  reg:
    maxItems: 1

  interrupts:
    maxItems: 1

  clocks:
    items:
      - description: AXI bus clock
      - description: Decoder core clock
      - description: APB register clock

  clock-names:
    items:
      - const: aclk
      - const: cclk
      - const: pclk

  resets:
    items:
      - description: APB register interface reset
      - description: AXI bus reset
      - description: Decoder core reset

  reset-names:
    items:
      - const: apb
      - const: axi
      - const: core

  power-domains:
    maxItems: 1

required:
  - compatible
  - reg
  - interrupts
  - clocks
  - clock-names
  - resets
  - reset-names
  - power-domains

additionalProperties: false

examples:
  - |
    #include <dt-bindings/interrupt-controller/irq.h>

    soc {
        #address-cells = <2>;
        #size-cells = <2>;

        video-codec@6800800 {
            compatible = "zhihe,a210-vc9000d";
            reg = <0x0 0x06800800 0x0 0xc00>;
            interrupts = <229 IRQ_TYPE_LEVEL_HIGH>;
            clocks = <&scmi_clk 163>, <&scmi_clk 164>, <&scmi_clk 165>;
            clock-names = "aclk", "cclk", "pclk";
            resets = <&scmi_reset 144>, <&scmi_reset 146>, <&scmi_reset 145>;
            reset-names = "apb", "axi", "core";
            power-domains = <&scmi_power 13>;
        };
    };
```

## Documentation/devicetree/bindings/pinctrl/zhihe,a210-pinctrl.yaml
```yaml
# SPDX-License-Identifier: (GPL-2.0-only OR BSD-2-Clause)
%YAML 1.2
---
$id: http://devicetree.org/schemas/pinctrl/zhihe,a210-pinctrl.yaml#
$schema: http://devicetree.org/meta-schemas/core.yaml#

title: Zhihe A210 pin controller

maintainers:
  - Zhiguo Zhu <zhiguo.zhu@linux.alibaba.com>

description: |
  Pinmux and pinconf controller of the Zhihe A210 RISC-V SoC.

  The pads of the A210 are split into four groups, each managed by its
  own pad controller with a separate register range:

    AON pad controller   -> zhihe,a210-aon-pinctrl
    Peripheral 1 pads    -> zhihe,a210-peri1-pinctrl
    Peripheral 2 pads    -> zhihe,a210-peri2-pinctrl
    Peripheral 3 pads    -> zhihe,a210-peri3-pinctrl

  Each pad can be muxed individually to up to 8 different functions,
  though for most pads only a few of those settings are valid. A few pads
  in the AON group do not support muxing or configuration at all.

  AON, peripheral 1 and peripheral 2 pads support configurable drive
  strength, bias, input enable, Schmitt trigger and slew rate.

  The peripheral 3 controller handles the six dedicated SDIO pads, named
  SDIO_CLK, SDIO_CMD and SDIO_DAT0 to SDIO_DAT3 in the SoC pin list. One
  mux bit selects SDIO or GPIO for all six pads at once, so they must all
  use the same function. Only their bias can be configured, per pad.

properties:
  compatible:
    enum:
      - zhihe,a210-aon-pinctrl
      - zhihe,a210-peri1-pinctrl
      - zhihe,a210-peri2-pinctrl
      - zhihe,a210-peri3-pinctrl

  reg:
    maxItems: 1

  clocks:
    maxItems: 1

  clock-names:
    const: pclk

  resets:
    maxItems: 1

patternProperties:
  '-[0-9]+$':
    type: object

    description:
      A pinmux group referenced by a consumer's pinctrl phandle. It
      contains one subnode per set of pads sharing the same pinmux and
      pinconf settings.

    additionalProperties: false

    patternProperties:
      '-pins$':
        type: object
        $ref: /schemas/pinctrl/pincfg-node.yaml#

        description:
          A pinctrl node describing the pinmux and pinconf settings of
          one or more pads.

        properties:
          pins:
            $ref: /schemas/pinctrl/pinmux-node.yaml#/properties/pins
            description: List of pads that properties in the node apply to.

          function:
            $ref: /schemas/pinctrl/pinmux-node.yaml#/properties/function
            enum: [ aouart, aouart_ir, aogpio, aoi2c, aospi, jtag, reset,
                    por, pmic, dvs, uart0, uart1, uart2, uart3, uart4,
                    uart5, uart6, uart7, uart8, uart9, uart_ir, gpio,
                    gmac0, gmac1, spi, qspi, pwm, can, i2s0, i2s1, i2s2,
                    i2s3, i2c0, i2c1, i2c2, i2c3, i2c4, i2c5, i2c6, i2c7,
                    i2c7_smb, sdio, isp0, dptx, usb31, sata, hdmi, zmac,
                    bsel, dbgm, cdbg, pdm, tdm, pcie, sen_vclk ]
            description: |
              The mux function to select for the given pins. Functions of
              the same kind share one name, such as spi or pwm, unless a
              pad can select more than one instance. For example GPIO0_16
              selects UART0 or UART1, so the UARTs are named uart0 to
              uart9.

          bias-disable: true

          bias-pull-up: true

          bias-pull-down: true

          drive-strength:
            minimum: 1
            maximum: 25
            description:
              Drive strength in mA. The pads support 1, 2, 3, 5, 7, 8, 10,
              12, 13, 15, 16, 18, 20, 21, 23 and 25 mA. Other values select
              the next higher strength.

          input-enable: true

          input-disable: true

          input-schmitt-enable: true

          input-schmitt-disable: true

          slew-rate:
            maximum: 1

        required:
          - pins

        additionalProperties: false

allOf:
  - if:
      properties:
        compatible:
          const: zhihe,a210-peri3-pinctrl
    then:
      patternProperties:
        '-[0-9]+$':
          patternProperties:
            '-pins$':
              properties:
                pins:
                  items:
                    enum: [ SDIO_CLK, SDIO_CMD, SDIO_DAT0, SDIO_DAT1,
                            SDIO_DAT2, SDIO_DAT3 ]

                function:
                  enum: [ sdio, gpio ]

                drive-strength: false

                input-enable: false

                input-disable: false

                input-schmitt-enable: false

                input-schmitt-disable: false

                slew-rate: false

required:
  - compatible
  - reg
  - clocks
  - clock-names

additionalProperties: false

examples:
  - |
    pinctrl@2026000 {
        compatible = "zhihe,a210-peri1-pinctrl";
        reg = <0x2026000 0x1000>;
        clocks = <&clk 0>;
        clock-names = "pclk";

        gmac0-0 {
            gmac0-pins {
                pins = "GPIO0_0", "GPIO0_12";
                function = "gmac0";
                bias-disable;
                drive-strength = <13>;
                input-disable;
                input-schmitt-disable;
                slew-rate = <0>;
            };
        };
    };

  - |
    pinctrl@542000 {
        compatible = "zhihe,a210-peri3-pinctrl";
        reg = <0x542000 0x1000>;
        clocks = <&clk 0>;
        clock-names = "pclk";

        sdio-0 {
            clock-pins {
                pins = "SDIO_CLK";
                function = "sdio";
                bias-disable;
            };

            cmd-data-pins {
                pins = "SDIO_CMD", "SDIO_DAT0", "SDIO_DAT1",
                       "SDIO_DAT2", "SDIO_DAT3";
                function = "sdio";
                bias-pull-up;
            };
        };
    };
```
