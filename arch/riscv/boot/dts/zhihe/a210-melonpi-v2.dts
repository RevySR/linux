// SPDX-License-Identifier: (GPL-2.0-only OR BSD-2-Clause)
/dts-v1/;

#include "a210-melonpi-common.dtsi"

/ {
	compatible = "zhihe,a210-melonpi-v2", "zhihe,a210-som", "zhihe,a210";
	model = "Melon Pi V2";
};
